## src/lamobo-d1/kernel/arch/arm/Kconfig
```kconfig
config ARCH_AK39
	bool "ANYKA AK39XX"
	select CPU_ARM926T
	select GENERIC_GPIO
	select ARCH_REQUIRE_GPIOLIB
	select CLKDEV_LOOKUP
#   select WIRELESS_EXT
	select ARCH_USES_GETTIMEOFFSET
	select ARCH_HAS_CPUFREQ
	help
	  Support for Anyka AK39xx series Chips platform.

source "arch/arm/mach-ak39/Kconfig"
source "arch/arm/plat-anyka/Kconfig"


config RAM_BASE
	hex "RAM physical starting address"
	depends on ARCH_AK39
	default 0x80000000
	help
	  ANYKA RAM physical starting address (in hex), default addr is 0x80000000 for Anyka platform.

config VIDEO_RESERVED_MEM_SIZE
	hex "Memory reserved for video decoding"
	depends on ARCH_AK39
	default 0x1A00000
	help
	  ANYKA H.264 decoder requires continuous physical RAM which do NOT cross
	  32MB boundary (Decoder IP requirement). So we have to reserve enough RAM
	  for H.264 decoding. Default size is 0x1A00000 (26MB) for AK39xx.
```

## src/lamobo-d1/kernel/drivers/crypto/Kconfig
```kconfig
config CRYPTO_DEV_ANYKA
	tristate "Support for Anyka crypto engine"
	depends on ARCH_AK39
	select CRYPTO_ALGAPI
	select CRYPTO_BLKCIPHER
	select CRYPTO_AES
	help
		This option allows you to have support for Anyka crypto engine.
		Select this to offload the Anyka crypto module for AES algorithms.
```

## src/lamobo-d1/kernel/drivers/gpu/ion/Kconfig
```kconfig
config ION_AK
	tristate "Ion for AK"
	depends on ION
	help
	  Choose this option if you wish to use ion on an AK platform.
```

## src/lamobo-d1/kernel/drivers/i2c/busses/Kconfig
```kconfig
config I2C_ANYKA
	bool "Anyka I2C drivers support"
	depends on ARCH_AK39
	help
	  Say Y here to enable support for I2C driver for Anyka chip.

choice
	bool "I2C driver"
	depends on I2C_ANYKA

config I2C_AK39_HW
	bool "i2c controller"
	depends on I2C_ANYKA
	help
	  Say Y here to enable support for I2C driver by chip controller.

config I2C_GPIO_SOFT
	bool "i2c software simulate by gpios"
	depends on I2C_ANYKA && I2C_ALGOBIT
	help
	  Say Y here to enable support I2C driver by GPIOs simulate

endchoice
```

## src/lamobo-d1/kernel/drivers/input/keyboard/Kconfig
```kconfig
config KEYBOARD_AKKEY
	tristate "Anyka gpio-keys support"
	depends on ARCH_AK39
	help
	  This driver implements support for buttons connected
	  to GPIO pins of various CPUs (and some other chips).

	  To compile this driver as a module, choose M here: the
	  module will be called akgpio_keys.

config KEYBOARD_AK_KEYPAD
	tristate "Anyka matrix-keypad support"
	depends on ARCH_AK39
	help
	  This driver implements support for buttons connected
	  to GPIO pins of various CPUs (and some other chips).

	  To compile this driver as a module, choose M here: the
	  module will be called ak_matrix_keypad.

config KEYBOARD_ADKEY
	tristate "ADC simulate gpio keys support"
	depends on ARCH_AK39
#	select INPUT_POLLDEV
	help
	  This driver implements support for AD-KEY connected
	  to ADC pin.

	  To compile this driver as a module, choose M here: the
	  module will be called akad-key.
```

## src/lamobo-d1/kernel/drivers/leds/Kconfig
```kconfig
config LEDS_AK39
	tristate "LED Support for the AK39 LEDS"
	depends on LEDS_CLASS && ARCH_AK39
	help
          This option enables support for the AK39 LEDS
```

## src/lamobo-d1/kernel/drivers/media/video/Kconfig
```kconfig
config VIDEO_AK
	tristate "AK Camera Interface driver"
	depends on VIDEO_DEV && SOC_CAMERA
	select VIDEOBUF_DMA_CONTIG
	---help---
	  This is a v4l2 driver for the AK Platform Camera Interface
```

## src/lamobo-d1/kernel/drivers/misc/Kconfig
```kconfig
config AK_SERIAL_NUMBER
	tristate "Anyka Serial Number Interface"
	depends on ARCH_AK39
	---help---
	 If you say yes here you get an sysfs interface to read device serial number 
	 on Anyka platform.

config AK_MOTOR
	tristate "Anyka Motor Support"
	default n
	help
	  If you say yes here you get support for the Anyka Motor device.

config AK_DAC_CLOCK
	tristate "Anyka Ak98 Dac Clock"
	depends on ARCH_AK39
	help
	If you say yes here you retrieve the elapsed time in dac driver

comment "user space generic gpio controller"
config GPIOS_AKCUSTOM
	tristate "Generic akgpio custom support"
	depends on ARCH_AK39
	help
		This enables anyka's generic GPIO for setting support through user space controller.
		if you want need to enable this, you can control attribute of akgpio,
		example dir[in/out], out[high/low], pull[up/down], get gpio level,
		irq polarity[low/high], request gpio irq and delete irq etc.

		If unsure, say N.
```

## src/lamobo-d1/kernel/drivers/mmc/card/Kconfig
```kconfig
config SDIO_WIFI
	tristate "SDIO WIFI support"
	depends on MMC_ANYKA
	default n
	help
		SDIO function driver for SDIO cards that implements the WIFI
		module.
```

## src/lamobo-d1/kernel/drivers/mmc/host/Kconfig
```kconfig
config MMC_ANYKA
	bool "ANYKA MMC/SD/SDIO Card Interface support"
	depends on ARCH_AK39
	help
	  This selects a driver for the MCI interface found in ANYKA's CPUs.
	  If you have a board based on one of those and a MMC/SD
	  slot, say Y here. If unsure, say N.
```

## src/lamobo-d1/kernel/drivers/mtd/devices/Kconfig
```kconfig
config MTD_AK_SPIFLASH
	tristate "Support Anyka SPI Flash chips(Most chips)"
	depends on SPI_MASTER
	help
		Anyka driver enables access to most SPI flash chips, used for
		program and data storage.

		Set up your spi devices with the right board-specific platform data,
		if you want to specify device partitioning or to use a device which
		doesn't support the JEDEC ID instruction.
```

## src/lamobo-d1/kernel/drivers/power/Kconfig
```kconfig
config BATTERY_AK
	tristate "Anyka Battery driver support"
	depends on ARCH_AK39
	help
	  Say Y to enable support for the anyka battery from SOCLE.
```

## src/lamobo-d1/kernel/drivers/rtc/Kconfig
```kconfig
config RTC_DRV_AK
	  tristate "AK RTC"
	  depends on ARCH_AK39
	  help
		  If you say Y here you will get support for the onboard AK RTC.
```

## src/lamobo-d1/kernel/drivers/spi/Kconfig
```kconfig
config SPI_ANYKA
     tristate "ANYKA SPI controller"
     depends on SPI_MASTER && (ARCH_AK98 || ARCH_AK39)
     select SPI_BITBANG
     help
       SPI driver for anyka ARM SoCs
       

# (slave support would go here)
config SPI_ANYKA_SLAVE
	tristate "ANYKA SPI slave controller "
    depends on (ARCH_AK98 || ARCH_AK39) && !SPI_ANYKA
    help
    	This is the SPI slave controller driver for anyka platform
```

## src/lamobo-d1/kernel/drivers/tty/serial/Kconfig
```kconfig
config SERIAL_AK39_UART
	tristate "AK39xx serial port support"
	select SERIAL_CORE
	depends on ARCH_AK39
	help
	  AK98 Uart support.

config SERIAL_AK39_CONSOLE
	bool "Console on AK39 serial port"
	depends on SERIAL_AK39_UART
	select SERIAL_CORE_CONSOLE
	help
	  Say Y here if you want enable console support on AK39xx serial port.

config SERIAL_GPIO_UART
	tristate "GPIO serial port support"
	select SERIAL_CORE
	depends on ARCH_AK39
	default n
	help
	  AK39 GPIO simulate UART support.

config SERIAL_GPIO_CONSOLE
	bool "Console on GPIO serial port"
	depends on SERIAL_GPIO_UART
	select SERIAL_CORE_CONSOLE
	help
          AK39 GPIO simulate UART console support.
```

## src/lamobo-d1/kernel/drivers/uio/Kconfig
```kconfig
config UIO_VCODEC
	tristate "Anyka Video Codec support"
	help
	  This driver supports Video HW Codec on Anyka SoC.

	  To compile this driver as a module, choose M here: the module
	  will be called uio_video_codec.
```

## src/lamobo-d1/kernel/drivers/usb/gadget/Kconfig
```kconfig
source "drivers/usb/gadget/plat-anyka/Kconfig"

config USB_FILE_STORAGE
	tristate "File-backed Storage Gadget (DEPRECATED)"
	depends on BLOCK
	help
	  The File-backed Storage Gadget acts as a USB Mass Storage
	  disk drive.  As its storage repository it can use a regular
	  file or a block device (in much the same way as the "loop"
	  device driver), specified as a module parameter.

	  Say "y" to link the driver statically, or "m" to build a
	  dynamically linked module called "g_file_storage".

	  NOTE: This driver is deprecated.  Its replacement is the
	  Mass Storage Gadget.

config USB_FILE_STORAGE_TEST
	bool "File-backed Storage Gadget testing version"
	depends on USB_FILE_STORAGE
	default n
	help
	  Say "y" to generate the larger testing version of the
	  File-backed Storage Gadget, useful for probing the
	  behavior of USB Mass Storage hosts.  Not needed for
	  normal operation.
```

## src/lamobo-d1/kernel/drivers/watchdog/Kconfig
```kconfig
choice
	prompt "ANYKA ak39 watchdog"
	default AK39_WATCHDOG
	depends on ARCH_AK39

config AK39_WATCHDOG
	bool "RTC"
	depends on ARCH_AK39
	help
	  Say Y here if you are using the rtc watchdog

config AK39_WATCHDOG_TOP
	bool "TOP"
	depends on ARCH_AK39
	help
	  Say Y here if you are using the top watchdog

config AK39_WATCHDOG_NONE
	bool "NONE"
	depends on ARCH_AK39
	help
	  Say Y here if you are not useing any watchdog

endchoice
```
